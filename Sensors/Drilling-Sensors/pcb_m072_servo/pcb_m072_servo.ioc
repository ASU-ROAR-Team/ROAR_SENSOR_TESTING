# file: pcb_m072_servo.ioc
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Mcu.Family=STM32F0
Mcu.Name=STM32F072C(8-B)Tx
Mcu.Package=LQFP48
PA13.Mode=Serial_Wire
PA13.Signal=SYS_SWDIO
PA14.Mode=Serial_Wire
PA14.Signal=SYS_SWCLK
PA2.Signal=S_TIM2_CH3
PF0-OSC_IN.Mode=HSE-External-Oscillator
PF0-OSC_IN.Signal=RCC_OSC_IN
PF1-OSC_OUT.Mode=HSE-External-Oscillator
PF1-OSC_OUT.Signal=RCC_OSC_OUT
ProjectManager.HeapSize=0x200
ProjectManager.StackSize=0x400
ProjectManager.TargetToolchain=STM32CubeIDE
RCC.AHBFreq_Value=8000000
RCC.APB1Freq_Value=8000000
RCC.APB1TimFreq_Value=8000000
RCC.HCLKFreq_Value=8000000
RCC.SYSCLKFreq_VALUE=8000000
SH.S_TIM2_CH3.0=TIM2_CH3,PWM Generation3 CH3
TIM2.Channel-PWM\ Generation3\ CH3=TIM_CHANNEL_3
TIM2.Period=9999
TIM2.Prescaler=15
board=custom

// file: Core/Src/main.c
/* USER CODE BEGIN Header */
/**
  ******************************************************************************
  * @file           : main.c
  * @brief          : Main program body
  ******************************************************************************
  * @attention
  *
  * Copyright (c) 2025 STMicroelectronics.
  * All rights reserved.
  *
  * This software is licensed under terms that can be found in the LICENSE file
  * in the root directory of this software component.
  * If no LICENSE file comes with this software, it is provided AS-IS.
  *
  ******************************************************************************
  */
/* USER CODE END Header */
#include "main.h"

/* USER CODE BEGIN PD */

#define MIN_PULSE_VALUE     250  // 0.5ms pulse for 0 degrees
#define MAX_PULSE_VALUE     1250 // 2.5ms pulse for 180 degrees
#define MID_PULSE_VALUE     750  // 1.5ms pulse for 90 degrees

/* USER CODE END PD */

TIM_HandleTypeDef htim2;

void SystemClock_Config(void);
static void MX_GPIO_Init(void);
static void MX_TIM2_Init(void);
/* USER CODE BEGIN PFP */

void setServoAngle(TIM_HandleTypeDef* htim, uint32_t channel, uint16_t angle);
uint16_t angleToPulseValue(uint16_t angle);

/* USER CODE END PFP */

/* USER CODE BEGIN 0 */

/**
 * @brief  Maps a desired angle (0-180) to the corresponding PWM pulse count.
 * @param  angle The desired angle in degrees (0 to 180).
 * @retval The calculated pulse value for the timer's compare register.
 */
uint16_t angleToPulseValue(uint16_t angle)
{
    // Clamp the angle to ensure it stays within 0-180 degrees
    if (angle > 180) {
        angle = 180;
    }

    // These values are correct for a 50Hz PWM with a Period of 9999 (10000 total counts)
    // which corresponds to a 20ms period.
    // 0.5ms pulse (0 deg)  -> (0.5ms / 20ms) * 10000 = 250
    // 2.5ms pulse (180 deg) -> (2.5ms / 20ms) * 10000 = 1250
    const uint16_t MIN_PULSE_COUNTS = 250;
    const uint16_t MAX_PULSE_COUNTS = 1250;
    const uint16_t PULSE_RANGE_COUNTS = MAX_PULSE_COUNTS - MIN_PULSE_COUNTS; // 1000 counts

    // Linear mapping formula:
    // pulse_counts = MIN_PULSE_COUNTS + (angle * PULSE_RANGE_COUNTS) / 180
    uint16_t pulse = MIN_PULSE_COUNTS + ((uint32_t)angle * PULSE_RANGE_COUNTS) / 180;

    return pulse;
}

/**
 * @brief  Sets the servo to a specific angle by updating the PWM compare register.
 * @param  htim A pointer to the TIM_HandleTypeDef structure for your timer.
 * @param  channel The timer channel used for the servo (e.g., TIM_CHANNEL_2).
 * @param  angle The desired servo angle in degrees (0 to 180).
 */
void setServoAngle(TIM_HandleTypeDef* htim, uint32_t channel, uint16_t angle)
{
    uint16_t pulse = angleToPulseValue(angle);

    // Update the Capture Compare Register (CCR) for the specified channel.
    __HAL_TIM_SET_COMPARE(htim, channel, pulse);
}

/* USER CODE END 0 */

int main(void)
{

  /* MCU Configuration--------------------------------------------------------*/

  /* Reset of all peripherals, Initializes the Flash interface and the Systick. */
  HAL_Init();

  /* Configure the system clock */
  SystemClock_Config();

  /* Initialize all configured peripherals */
  MX_GPIO_Init();
  MX_TIM2_Init();
  /* USER CODE BEGIN 2 */

  	// Start the PWM signal on TIM2 Channel 2
    HAL_TIM_PWM_Start(&htim2, TIM_CHANNEL_3);

	// Set initial position to center (90 degrees)
	setServoAngle(&htim2, TIM_CHANNEL_3, 90);
	HAL_Delay(1000); // Give servo time to reach initial position

  /* USER CODE END 2 */

  /* Infinite loop */
  /* USER CODE BEGIN WHILE */
  while (1)
  {
	  setServoAngle(&htim2, TIM_CHANNEL_3, 0);
	  HAL_Delay(1500);
	  setServoAngle(&htim2, TIM_CHANNEL_3, 90);
	  HAL_Delay(1500);
	  setServoAngle(&htim2, TIM_CHANNEL_3, 180);
	  HAL_Delay(1500);

    /* USER CODE END WHILE */

  }
}

void SystemClock_Config(void)
{
  RCC_OscInitTypeDef RCC_OscInitStruct = {0};
  RCC_ClkInitTypeDef RCC_ClkInitStruct = {0};

  /** Initializes the RCC Oscillators according to the specified parameters
  * in the RCC_OscInitTypeDef structure.
  */
  RCC_OscInitStruct.OscillatorType = RCC_OSCILLATORTYPE_HSI;
  RCC_OscInitStruct.HSIState = RCC_HSI_ON;
  RCC_OscInitStruct.HSICalibrationValue = RCC_HSICALIBRATION_DEFAULT;
  RCC_OscInitStruct.PLL.PLLState = RCC_PLL_NONE;
  if (HAL_RCC_OscConfig(&RCC_OscInitStruct) != HAL_OK)
  {
    Error_Handler();
  }

  /** Initializes the CPU, AHB and APB buses clocks
  */
  RCC_ClkInitStruct.ClockType = RCC_CLOCKTYPE_HCLK|RCC_CLOCKTYPE_SYSCLK
                              |RCC_CLOCKTYPE_PCLK1;
  RCC_ClkInitStruct.SYSCLKSource = RCC_SYSCLKSOURCE_HSI;
  RCC_ClkInitStruct.AHBCLKDivider = RCC_SYSCLK_DIV1;
  RCC_ClkInitStruct.APB1CLKDivider = RCC_HCLK_DIV1;

  if (HAL_RCC_ClockConfig(&RCC_ClkInitStruct, FLASH_LATENCY_0) != HAL_OK)
  {
    Error_Handler();
  }
}

static void MX_TIM2_Init(void)
{

  TIM_MasterConfigTypeDef sMasterConfig = {0};
  TIM_OC_InitTypeDef sConfigOC = {0};

  htim2.Instance = TIM2;
  htim2.Init.Prescaler = 15;
  htim2.Init.CounterMode = TIM_COUNTERMODE_UP;
  htim2.Init.Period = 9999;
  htim2.Init.ClockDivision = TIM_CLOCKDIVISION_DIV1;
  htim2.Init.AutoReloadPreload = TIM_AUTORELOAD_PRELOAD_DISABLE;
  if (HAL_TIM_PWM_Init(&htim2) != HAL_OK)
  {
    Error_Handler();
  }
  sMasterConfig.MasterOutputTrigger = TIM_TRGO_RESET;
  sMasterConfig.MasterSlaveMode = TIM_MASTERSLAVEMODE_DISABLE;
  if (HAL_TIMEx_MasterConfigSynchronization(&htim2, &sMasterConfig) != HAL_OK)
  {
    Error_Handler();
  }
  sConfigOC.OCMode = TIM_OCMODE_PWM1;
  sConfigOC.Pulse = 0;
  sConfigOC.OCPolarity = TIM_OCPOLARITY_HIGH;
  sConfigOC.OCFastMode = TIM_OCFAST_DISABLE;
  if (HAL_TIM_PWM_ConfigChannel(&htim2, &sConfigOC, TIM_CHANNEL_3) != HAL_OK)
  {
    Error_Handler();
  }
  HAL_TIM_MspPostInit(&htim2);

}

static void MX_GPIO_Init(void)
{

  /* GPIO Ports Clock Enable */
  __HAL_RCC_GPIOF_CLK_ENABLE();
  __HAL_RCC_GPIOA_CLK_ENABLE();

}

void Error_Handler(void)
{
  __disable_irq();
  while (1)
  {
  }
}
